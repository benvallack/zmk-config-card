## config/boards/shields/card/Kconfig.defconfig
```kconfig
# Copyright (c) 2020 The ZMK Contributors
# SPDX-License-Identifier: MIT

config ZMK_BLE
	default y

config ZMK_USB
	default y

if SHIELD_CARD_DONGLE

config ZMK_KEYBOARD_NAME
	default "The Card Dongle"

endif

if SHIELD_CARD_LEFT || SHIELD_CARD_RIGHT

config ZMK_SPLIT
	default y

endif



if SHIELD_CARD_DONGLE 

config ZMK_SPLIT
	default y

config ZMK_SPLIT_BLE_ROLE_CENTRAL
	default y

endif
```

## config/boards/shields/card/Kconfig.shield
```kconfig
# Copyright (c) 2020 The ZMK Contributors
# SPDX-License-Identifier: MIT

config SHIELD_CARD_LEFT
	def_bool $(shields_list_contains,card_left)

config SHIELD_CARD_RIGHT
	def_bool $(shields_list_contains,card_right)

config SHIELD_CARD_DONGLE
	def_bool $(shields_list_contains,card_dongle)
```

## config/west.yml
```yaml
manifest:
  remotes:
    - name: benvallack
      url-base: https://github.com/benvallack
  projects:
    - name: zmk
      remote: benvallack
      revision: with-tap-dance
      import: app/west.yml
  self:
    path: config
```
